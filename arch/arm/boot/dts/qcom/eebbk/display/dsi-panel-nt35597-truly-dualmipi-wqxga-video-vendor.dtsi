/* Copyright (c) 2016-2017, The Linux Foundation. All rights reserved.
 *
 * This program is free software; you can redistribute it and/or modify
 * it under the terms of the GNU General Public License version 2 and
 * only version 2 as published by the Free Software Foundation.
 *
 * This program is distributed in the hope that it will be useful,
 * but WITHOUT ANY WARRANTY; without even the implied warranty of
 * MERCHANTABILITY or FITNESS FOR A PARTICULAR PURPOSE.  See the
 * GNU General Public License for more details.
 */

&mdss_mdp {
	dsi_dual_nt35597_truly_video: qcom,mdss_dsi_nt35597_wqxga_video_truly {
		qcom,mdss-dsi-panel-name =
			"Dual nt35597 video mode dsi truly panel without DSC";
		qcom,mdss-dsi-panel-type = "dsi_video_mode";
		qcom,mdss-dsi-panel-framerate = <60>;
		qcom,mdss-dsi-virtual-channel-id = <0>;
		qcom,mdss-dsi-stream = <0>;
		qcom,mdss-dsi-panel-width = <800>;
		qcom,mdss-dsi-panel-height = <2176>;
		qcom,mdss-dsi-h-front-porch = <25>;
		qcom,mdss-dsi-h-back-porch = <25>;
		qcom,mdss-dsi-h-pulse-width = <14>;
		qcom,mdss-dsi-h-sync-skew = <0>;
		qcom,mdss-dsi-v-back-porch = <73>;
		qcom,mdss-dsi-v-front-porch = <250>;
		qcom,mdss-dsi-v-pulse-width = <8>;
		qcom,mdss-dsi-bpp = <24>;
		qcom,mdss-dsi-underflow-color = <0x3ff>;
		qcom,mdss-dsi-border-color = <0>;
		qcom,mdss-dsi-on-command = [
			05 01 00 00 78 00 02 11
			00 39 01 00 00 00 00 03
			50 5A 0E 39 01 00 00 00
			00 04 83 AC B6 6D 39 01
			00 00 00 00 03 50 5A 19
			39 01 00 00 00 00 11 80
			92 8E 8C 8A 88 87 86 84
			83 82 81 81 55 55 F6 2F
			39 01 00 00 00 00 08 90
			F3 FF FF EF BF 7F 0F 39
			01 00 00 00 00 03 A1 00
			48 39 01 00 00 00 00 03
			50 5A 23 39 01 00 00 00
			00 03 90 FF 0F 39 01 00
			00 00 00 03 94 2C 01 05
			01 00 00 01 00 02 29 00
			];
		qcom,mdss-dsi-off-command = [05 01 00 00 01 00 02 28 00
				 05 01 00 00 78 00 02 10 00];
		qcom,mdss-dsi-on-command-state = "dsi_lp_mode";
		qcom,mdss-dsi-off-command-state = "dsi_lp_mode";
		qcom,mdss-dsi-h-sync-pulse = <0>;
		qcom,mdss-dsi-traffic-mode = "burst_mode";
		qcom,mdss-dsi-bllp-eof-power-mode;
		qcom,mdss-dsi-bllp-power-mode;
		qcom,mdss-dsi-lane-0-state;
		qcom,mdss-dsi-lane-1-state;
		qcom,mdss-dsi-lane-2-state;
		qcom,mdss-dsi-lane-3-state;
		qcom,mdss-dsi-panel-timings = [e2 36 24 00 66 6a 28 38 2a 03
				04 00];
		qcom,mdss-dsi-t-clk-post = <0x7f>;
		qcom,mdss-dsi-t-clk-pre = <0x0a>;
		qcom,mdss-dsi-dma-trigger = "trigger_sw";
		qcom,mdss-dsi-mdp-trigger = "none";
		qcom,mdss-dsi-reset-sequence = <1 10>, <0 5>, <1 25>;
		qcom,mdss-dsi-tx-eot-append;
		qcom,mdss-pan-physical-width-dimension = <147>;
		qcom,mdss-pan-physical-height-dimension = <197>;

		qcom,config-select = <&dsi_dual_nt35597_truly_video_config0>;

		dsi_dual_nt35597_truly_video_config0: config0 {
			qcom,split-mode = "dualctl-split";
		};
	};
};
